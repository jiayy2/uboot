## configs/itop4412_defconfig
```kconfig
###########################################################
# 基本配置
############################################################
CONFIG_ARM=y
CONFIG_ARCH_EXYNOS=y
CONFIG_ARCH_EXYNOS4=y
CONFIG_TARGET_ITOP4412=y
CONFIG_SYS_TEXT_BASE=0x43E00000

###########################################################
# 串口配置
###########################################################
CONFIG_SYS_PROMPT="uboot $ "


############################################################
# SPL配置信息
############################################################
CONFIG_SPL=y
CONFIG_SPL_FRAMEWORK=n  #关闭SPL框架

#############################################################
# 设备树配置信息
#############################################################
CONFIG_OF_CONTROL=y
#CONFIG_OF_EMBED=y
CONFIG_DEFAULT_DEVICE_TREE="exynos4412-itop4412"

############################################################
# 驱动配置信息
###########################################################
CONFIG_DM=y
CONFIG_DM_MMC=y

#eMMC, SD Card
CONFIG_CMD_MMC=y
CONFIG_MMC=y
CONFIG_MMC_SDHCI=y
CONFIG_MMC_SDHCI_S5P=y
CONFIG_MMC_DW=y

#USB
CONFIG_USB=y
CONFIG_DM_USB=y
CONFIG_CMD_USB=y

CONFIG_USB_HOST=y
CONFIG_USB_EHCI_HCD=y
CONFIG_USB_STORAGE=y

CONFIG_USB_GADGET=y
CONFIG_USB_GADGET_MANUFACTURER="samsung"
CONFIG_USB_GADGET_VENDOR_NUM=0x04E8
CONFIG_USB_GADGET_PRODUCT_NUM=0x685D
CONFIG_USB_GADGET_DWC2_OTG=y
CONFIG_USB_GADGET_VBUS_DRAW=2
CONFIG_USB_GADGET_DUALSPEED=y
CONFIG_USB_GADGET_DOWNLOAD=y
```
